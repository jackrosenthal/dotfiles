## Kconfig
```kconfig
choice
	prompt "OS Distribution"

config DISTRO_GENERIC
	bool "Generic (Unknown)"

config DISTRO_ARCH
	bool "Arch Linux-like"

config DISTRO_DEBIAN
	bool "Debian-like"

endchoice

menuconfig DEVTOOLS

menuconfig X11
	bool "X11"
	default y
	help
	  This device has X11 installed for graphical display output.

if X11

choice
	prompt "Window manager"

config I3WM
	bool "i3 Window Mangaer"
	help
	  Use i3 Window Manager

endchoice

config WEB_BROWSER
	string "Path to web browser"
	default "/usr/bin/google-chrome-stable" if PKG_GOOGLE_CHROME
	default "/usr/bin/chromium" if PKG_CHROMIUM
	default "/usr/bin/firefox" if PKG_FIREFOX
	help
	  Path to the default web browser

config PKG_GOOGLE_CHROME
	bool "Install Google Chrome browser"
	depends on !DISTRO_GENERIC
	default y
	help
	  Install Google Chrome browser

config PKG_CHROMIUM
	bool "Install Chromium browser"
	depends on !DISTRO_GENERIC
	default y if !PKG_GOOGLE_CHROME
	help
	  Install open source Chromium browser

config PKG_FIREFOX
	bool "Install Firefox browser"
	depends on !DISTRO_GENERIC
	help
	  Install Firefox browser

menuconfig XSECURELOCK
	bool "Install xsecurelock"

endif # X11
```
